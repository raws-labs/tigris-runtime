## examples/esp32/sdkconfig.defaults.esp32
```kconfig
# ESP32-WROOM-32 (4 MB flash, no PSRAM)
CONFIG_ESP_DEFAULT_CPU_FREQ_MHZ_240=y
CONFIG_ESPTOOLPY_FLASHSIZE_4MB=y
CONFIG_PARTITION_TABLE_CUSTOM_FILENAME="partitions_esp32.csv"
```
